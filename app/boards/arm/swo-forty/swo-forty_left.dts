//swo-forty_left.dts

#include "swo-forty.dtsi"

&kscan0 {
	col-gpios
	= <&gpio0 7  GPIO_ACTIVE_HIGH>
		, <&gpio0 31 GPIO_ACTIVE_HIGH>
		, <&gpio0 30 GPIO_ACTIVE_HIGH>
		, <&gpio0 29 GPIO_ACTIVE_HIGH>
		, <&gpio0 28 GPIO_ACTIVE_HIGH>
		, <&gpio0 2  GPIO_ACTIVE_HIGH>
		;
};