## app/boards/arm/swo-forty/Kconfig.board
```kconfig
# swo-forty board configuration

# Copyright (c) 2020 The ZMK Contributors
# SPDX-License-Identifier: MIT

# config BOARD_SWO_FORTY_LEFT
# 	bool "swo-forty_left"
# 	depends on SOC_NRF52840_QIAA
# 
# config BOARD_SWO_FORTY_RIGHT
# 	bool "swo-forty_right"
# 	depends on SOC_NRF52840_QIAA

config BOARD_SWO_FORTY
	bool "swo-forty"
 	depends on SOC_NRF52840_QIAA
```

## app/boards/arm/swo-forty/Kconfig.defconfig
```kconfig
# Copyright (c) 2020 The ZMK Contributors
# SPDX-License-Identifier: MIT

if BOARD_SWO_FORTY_LEFT

config ZMK_KEYBOARD_NAME
    default "swo-forty"

config ZMK_SPLIT_BLE_ROLE_CENTRAL
    default y

endif

if BOARD_SWO_FORTY_LEFT || BOARD_SWO_FORTY_RIGHT

if USB

config USB_NRFX
    default y

config USB_DEVICE_STACK
    default y

endif # USB

config BT_CTLR
    default BT

config ZMK_BLE
    default y

config ZMK_USB
    default y

config ZMK_BATTERY_VOLTAGE_DIVIDER
    default y

config ZMK_SPLIT
    default y

endif
```
